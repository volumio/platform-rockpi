/dts-v1/;
/plugin/;

/ {
	fragment@0 {
		target = <&cpu0_opp_table>;
		__overlay__ {
			//the following are unsupported, overclocked operating points
			opp-1200000000 {
				opp-hz = /bits/ 64 <1200000000>;
				opp-microvolt = <1200000 1200000 1340000>;
				clock-latency-ns = <40000>;
				status = "okay";
			};
		};
	};
};
